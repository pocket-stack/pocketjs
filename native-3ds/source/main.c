// PocketJS 3DS host — the 3DS analogue of native/src/main.rs (PSP) and
// host-web/engine.js (web). It boots QuickJS, exposes the `globalThis.ui` op
// surface (forwarding to the Rust bridge pocketjs-3ds-ffi), evaluates the same
// bundled Solid app, and per vblank ticks the core and presents its frame.
//
// ── SCAFFOLD ──────────────────────────────────────────────────────────────
// This file is complete and faithful to the proven dreamcart runtime-3ds host
// (same QuickJS boot, aptMainLoop frame loop, and 3DS→PSP button mapping) and
// to native/src/ffi.rs (the ui.* op set + __textures table), but it has NOT
// been compiled or run — the 3DS toolchain (devkitPro) is not installed in the
// authoring environment. Build + run it per native-3ds/README.md. Two spots
// need on-device confirmation and are marked "VERIFY ON DEVICE".
//
// v1 render path = present pj_render()'s software-rasterized RGBA framebuffer
// directly to the top screen (libctru gfx, no citro). With the "3ds" device
// profile the core lays out natively at 400×240, so the framebuffer maps 1:1 to
// the top screen — no scaling. A GPU-native DrawList→citro3d backend (mirroring
// native/src/ge.rs) is the documented v2; see README.md.

#include <3ds.h>
#include <stdio.h>
#include <string.h>

#include "quickjs.h"
#include "pocketjs_ffi.h"
#include "game_js.h"   // generated by gen-game.ts: GAME_JS[], GAME_JS_LEN
#include "game_pak.h"  // generated by gen-game.ts: GAME_PAK[], GAME_PAK_LEN

// libctru weak symbols (override the crt0 defaults).
//
// __stacksize__: the 3dsx main-thread stack defaults to ~32 KB, which QuickJS
// overflows while parsing/compiling a large bundle (its recursive-descent
// parser is deeply nested) — the exact reason native/src/main.rs runs QuickJS on
// a 2 MB PSP worker thread. Give the main thread the same 2 MB here (a stack
// overflow shows up as register spills writing below the stack, then PC→0).
u32 __stacksize__ = 2 * 1024 * 1024;

// FCRAM split: a cached general heap (newlib malloc — where the QuickJS C
// allocator lives) + a GPU-visible linear heap. Bias toward the general heap
// (v1 renders via gfx, whose framebuffers live in VRAM, and uses no GPU
// vertex/texture buffers, so linear can be small). Tune per app; probe at
// runtime with linearSpaceFree(). See native-3ds/README.md "Memory".
u32 __ctru_heap_size        = 40 * 1024 * 1024;
u32 __ctru_linear_heap_size = 12 * 1024 * 1024;

// QuickJS (the dreamcart fork) calls debug_log() during init; provide it.
void debug_log(const char *msg, int a) { (void)a; printf("[qjs] %s\n", msg); }

// ── arg helpers ────────────────────────────────────────────────────────────

static int32_t arg_i32(JSContext *ctx, int argc, JSValueConst *argv, int i) {
    int32_t v = 0;
    if (i < argc) JS_ToInt32(ctx, &v, argv[i]);
    return v;
}
static double arg_f64(JSContext *ctx, int argc, JSValueConst *argv, int i) {
    double v = 0.0;
    if (i < argc) JS_ToFloat64(ctx, &v, argv[i]);
    return v;
}

// Borrow the bytes behind an ArrayBuffer OR a typed-array view (host.ts passes
// Uint8Arrays), mirroring native/src/ffi.rs buffer_bytes. Pointer is valid only
// until the next JS allocation — consume it before returning to JS.
static uint8_t *buffer_bytes(JSContext *ctx, JSValueConst val, size_t *out_len) {
    size_t len = 0;
    uint8_t *p = JS_GetArrayBuffer(ctx, &len, val);
    if (p) { *out_len = len; return p; }
    JS_FreeValue(ctx, JS_GetException(ctx)); // clear the pending TypeError
    JSValue buf = JS_GetPropertyStr(ctx, val, "buffer");
    size_t blen = 0;
    uint8_t *bp = JS_GetArrayBuffer(ctx, &blen, buf);
    JS_FreeValue(ctx, buf);
    if (!bp) { JS_FreeValue(ctx, JS_GetException(ctx)); return NULL; }
    int32_t off = 0, vlen = 0;
    JSValue ov = JS_GetPropertyStr(ctx, val, "byteOffset");
    JS_ToInt32(ctx, &off, ov); JS_FreeValue(ctx, ov);
    JSValue lv = JS_GetPropertyStr(ctx, val, "byteLength");
    JS_ToInt32(ctx, &vlen, lv); JS_FreeValue(ctx, lv);
    if (off < 0 || vlen < 0 || (size_t)(off + vlen) > blen) return NULL;
    *out_len = (size_t)vlen;
    return bp + off;
}

// ── ui.* ops — forward to the Rust bridge (pj_*) ───────────────────────────

static JSValue ui_createNode(JSContext *ctx, JSValueConst t, int argc, JSValueConst *argv) {
    (void)t; return JS_NewInt32(ctx, pj_create_node((uint32_t)arg_i32(ctx, argc, argv, 0)));
}
static JSValue ui_destroyNode(JSContext *ctx, JSValueConst t, int argc, JSValueConst *argv) {
    (void)t; pj_destroy_node(arg_i32(ctx, argc, argv, 0)); return JS_UNDEFINED;
}
static JSValue ui_insertBefore(JSContext *ctx, JSValueConst t, int argc, JSValueConst *argv) {
    (void)t; pj_insert_before(arg_i32(ctx, argc, argv, 0), arg_i32(ctx, argc, argv, 1), arg_i32(ctx, argc, argv, 2)); return JS_UNDEFINED;
}
static JSValue ui_removeChild(JSContext *ctx, JSValueConst t, int argc, JSValueConst *argv) {
    (void)t; pj_remove_child(arg_i32(ctx, argc, argv, 0), arg_i32(ctx, argc, argv, 1)); return JS_UNDEFINED;
}
static JSValue ui_setStyle(JSContext *ctx, JSValueConst t, int argc, JSValueConst *argv) {
    (void)t; pj_set_style(arg_i32(ctx, argc, argv, 0), arg_i32(ctx, argc, argv, 1)); return JS_UNDEFINED;
}
static JSValue ui_setProp(JSContext *ctx, JSValueConst t, int argc, JSValueConst *argv) {
    (void)t; pj_set_prop(arg_i32(ctx, argc, argv, 0), (uint32_t)arg_i32(ctx, argc, argv, 1), arg_f64(ctx, argc, argv, 2)); return JS_UNDEFINED;
}
static JSValue ui_setText_impl(JSContext *ctx, int argc, JSValueConst *argv, int replace) {
    if (argc < 2) return JS_UNDEFINED;
    size_t len = 0;
    const char *s = JS_ToCStringLen(ctx, &len, argv[1]);
    if (!s) return JS_UNDEFINED;
    int32_t id = arg_i32(ctx, argc, argv, 0);
    if (replace) pj_replace_text(id, (const uint8_t *)s, len);
    else         pj_set_text(id, (const uint8_t *)s, len);
    JS_FreeCString(ctx, s);
    return JS_UNDEFINED;
}
static JSValue ui_setText(JSContext *ctx, JSValueConst t, int argc, JSValueConst *argv) {
    (void)t; return ui_setText_impl(ctx, argc, argv, 0);
}
static JSValue ui_replaceText(JSContext *ctx, JSValueConst t, int argc, JSValueConst *argv) {
    (void)t; return ui_setText_impl(ctx, argc, argv, 1);
}
static JSValue ui_uploadTexture(JSContext *ctx, JSValueConst t, int argc, JSValueConst *argv) {
    (void)t;
    if (argc < 4) return JS_NewInt32(ctx, -1);
    size_t len = 0;
    uint8_t *p = buffer_bytes(ctx, argv[0], &len);
    if (!p) return JS_NewInt32(ctx, -1);
    int32_t h = pj_upload_texture(p, len, (uint32_t)arg_i32(ctx, argc, argv, 1),
                                  (uint32_t)arg_i32(ctx, argc, argv, 2),
                                  (uint32_t)arg_i32(ctx, argc, argv, 3));
    return JS_NewInt32(ctx, h);
}
static JSValue ui_setImage(JSContext *ctx, JSValueConst t, int argc, JSValueConst *argv) {
    (void)t; pj_set_image(arg_i32(ctx, argc, argv, 0), arg_i32(ctx, argc, argv, 1)); return JS_UNDEFINED;
}
static JSValue ui_animate(JSContext *ctx, JSValueConst t, int argc, JSValueConst *argv) {
    (void)t;
    int32_t h = pj_animate(arg_i32(ctx, argc, argv, 0), (uint32_t)arg_i32(ctx, argc, argv, 1),
                           arg_f64(ctx, argc, argv, 2), (uint32_t)arg_i32(ctx, argc, argv, 3),
                           (uint32_t)arg_i32(ctx, argc, argv, 4), (uint32_t)arg_i32(ctx, argc, argv, 5));
    return JS_NewInt32(ctx, h);
}
static JSValue ui_cancelAnim(JSContext *ctx, JSValueConst t, int argc, JSValueConst *argv) {
    (void)t; pj_cancel_anim(arg_i32(ctx, argc, argv, 0)); return JS_UNDEFINED;
}
static JSValue ui_setFocus(JSContext *ctx, JSValueConst t, int argc, JSValueConst *argv) {
    (void)t; pj_set_focus(arg_i32(ctx, argc, argv, 0)); return JS_UNDEFINED;
}
static JSValue ui_loadStyles(JSContext *ctx, JSValueConst t, int argc, JSValueConst *argv) {
    (void)t;
    size_t len = 0; uint8_t *p = argc >= 1 ? buffer_bytes(ctx, argv[0], &len) : NULL;
    return JS_NewBool(ctx, p ? pj_load_styles(p, len) : 0);
}
static JSValue ui_loadFontAtlas(JSContext *ctx, JSValueConst t, int argc, JSValueConst *argv) {
    (void)t;
    size_t len = 0; uint8_t *p = argc >= 1 ? buffer_bytes(ctx, argv[0], &len) : NULL;
    return JS_NewBool(ctx, p ? pj_load_font_atlas(p, len) : 0);
}
static JSValue ui_measureText(JSContext *ctx, JSValueConst t, int argc, JSValueConst *argv) {
    (void)t;
    if (argc < 1) return JS_NewFloat64(ctx, 0.0);
    size_t len = 0;
    const char *s = JS_ToCStringLen(ctx, &len, argv[0]);
    if (!s) return JS_NewFloat64(ctx, 0.0);
    float w = pj_measure_text((const uint8_t *)s, len, (uint32_t)arg_i32(ctx, argc, argv, 1));
    JS_FreeCString(ctx, s);
    return JS_NewFloat64(ctx, (double)w);
}

static void add_fn(JSContext *ctx, JSValue obj, const char *name,
                   JSCFunction *fn, int nargs) {
    JS_SetPropertyStr(ctx, obj, name, JS_NewCFunction(ctx, fn, name, nargs));
}

// Install globalThis.ui (full op surface + __textures), mirroring
// native/src/ffi.rs register(). pj_feed_pak must have run first so the texture
// table is populated.
static void register_ui(JSContext *ctx, JSValue global) {
    JSValue ui = JS_NewObject(ctx);
    add_fn(ctx, ui, "createNode", ui_createNode, 1);
    add_fn(ctx, ui, "destroyNode", ui_destroyNode, 1);
    add_fn(ctx, ui, "insertBefore", ui_insertBefore, 3);
    add_fn(ctx, ui, "removeChild", ui_removeChild, 2);
    add_fn(ctx, ui, "setStyle", ui_setStyle, 2);
    add_fn(ctx, ui, "setProp", ui_setProp, 3);
    add_fn(ctx, ui, "setText", ui_setText, 2);
    add_fn(ctx, ui, "replaceText", ui_replaceText, 2);
    add_fn(ctx, ui, "uploadTexture", ui_uploadTexture, 4);
    add_fn(ctx, ui, "setImage", ui_setImage, 2);
    add_fn(ctx, ui, "animate", ui_animate, 6);
    add_fn(ctx, ui, "cancelAnim", ui_cancelAnim, 1);
    add_fn(ctx, ui, "setFocus", ui_setFocus, 1);
    add_fn(ctx, ui, "loadStyles", ui_loadStyles, 1);
    add_fn(ctx, ui, "loadFontAtlas", ui_loadFontAtlas, 1);
    add_fn(ctx, ui, "measureText", ui_measureText, 2);

    // ui.__textures: pak image name -> handle. Presence of __textures also tells
    // the JS runtime (src/host.ts) to treat this as the native "psp"-kind host
    // (non-strict; skip the loadStyles/loadFontAtlas re-feed pj_feed_pak did).
    JSValue tex = JS_NewObject(ctx);
    int n = pj_texture_count();
    for (int i = 0; i < n; i++) {
        char name[128];
        if (pj_texture_name(i, (uint8_t *)name, sizeof name) >= 0) {
            JS_SetPropertyStr(ctx, tex, name, JS_NewInt32(ctx, pj_texture_handle(i)));
        }
    }
    JS_SetPropertyStr(ctx, ui, "__textures", tex);
    JS_SetPropertyStr(ctx, global, "ui", ui);
}

// ── present ────────────────────────────────────────────────────────────────

// Copy pj_render()'s SCREEN_W×SCREEN_H RGBA8 framebuffer onto the top screen.
// The top screen is scanned rotated 90°: gfxGetFramebuffer returns a buffer
// whose fast axis is Y (physical height 240), so pixel (x, y) lives at
// fb[(x*240 + (239 - y)) * 4]. When the app is built with the "3ds" profile,
// SCREEN_W×SCREEN_H is exactly 400×240 = the top screen, so this is a 1:1 copy
// (no scaling); a smaller surface is centered.
static void present(const uint8_t *src, uint32_t sw, uint32_t sh) {
    u16 fbw = 0, fbh = 0;
    u8 *fb = gfxGetFramebuffer(GFX_TOP, GFX_LEFT, &fbw, &fbh); // fbw=240, fbh=400
    const int TW = 400, TH = 240;
    int ox = (TW - (int)sw) / 2, oy = (TH - (int)sh) / 2;
    if (ox < 0) ox = 0;
    if (oy < 0) oy = 0;
    for (uint32_t y = 0; y < sh && (int)y < TH; y++) {
        for (uint32_t x = 0; x < sw && (int)x < TW; x++) {
            const uint8_t *p = src + (y * sw + x) * 4;      // R,G,B,A (spec ABGR LE)
            int px = ox + (int)x, py = oy + (int)y;
            u8 *d = fb + ((px * TH) + (TH - 1 - py)) * 4;
            // VERIFY ON DEVICE: GSP_RGBA8_OES byte order. pj_render gives bytes
            // R,G,B,A; the 3DS RGBA8 framebuffer is commonly written A,B,G,R.
            // If colors look swapped, this is the one line to flip.
            d[0] = p[3]; d[1] = p[2]; d[2] = p[1]; d[3] = p[0];
        }
    }
}

static void dump_exception(JSContext *ctx) {
    JSValue e = JS_GetException(ctx);
    const char *s = JS_ToCString(ctx, e);
    if (s) { printf("JS error: %s\n", s); JS_FreeCString(ctx, s); }
    JS_FreeValue(ctx, e);
}

int main(int argc, char **argv) {
    (void)argc; (void)argv;
    gfxInitDefault();
    gfxSetScreenFormat(GFX_TOP, GSP_RGBA8_OES);
    gfxSetDoubleBuffering(GFX_TOP, true);
    consoleInit(GFX_BOTTOM, NULL); // logs on the bottom screen

    printf("PocketJS (3DS) booting QuickJS...\n");
    printf("START+SELECT to quit.\n");

    // Core first: create the Ui, then feed the embedded asset pack natively
    // (styles + atlases + images) BEFORE any JS runs — zero QuickJS-heap transit,
    // parity with native/src/pak.rs.
    pj_init();
    if (GAME_PAK_LEN > 0) pj_feed_pak(GAME_PAK, GAME_PAK_LEN);

    JSRuntime *rt = JS_NewRuntime();
    JSContext *ctx = JS_NewContext(rt);
    JSValue global = JS_GetGlobalObject(ctx);
    register_ui(ctx, global);

    JSValue res = JS_Eval(ctx, (const char *)GAME_JS, GAME_JS_LEN, "app.js", JS_EVAL_TYPE_GLOBAL);
    if (JS_IsException(res)) dump_exception(ctx);
    JS_FreeValue(ctx, res);

    JSValue frame = JS_GetPropertyStr(ctx, global, "frame");
    int have_frame = JS_IsFunction(ctx, frame);
    if (!have_frame) printf("WARN: app defined no global frame()\n");

    uint32_t sw = pj_screen_w(), sh = pj_screen_h();

    while (aptMainLoop()) {
        hidScanInput();
        u32 k = hidKeysHeld();
        if ((k & KEY_START) && (k & KEY_SELECT)) break;

        // 3DS keys -> canonical PSP button bitmask (spec/spec.ts BTN; identical
        // mapping to the proven dreamcart runtime-3ds host). Circle-pad folds
        // onto the d-pad so analog nav works too.
        int mask = 0;
        if (k & (KEY_UP    | KEY_CPAD_UP))    mask |= 0x10;   // UP
        if (k & (KEY_RIGHT | KEY_CPAD_RIGHT)) mask |= 0x20;   // RIGHT
        if (k & (KEY_DOWN  | KEY_CPAD_DOWN))  mask |= 0x40;   // DOWN
        if (k & (KEY_LEFT  | KEY_CPAD_LEFT))  mask |= 0x80;   // LEFT
        if (k & KEY_A)      mask |= 0x4000;  // CROSS
        if (k & KEY_B)      mask |= 0x2000;  // CIRCLE
        if (k & KEY_X)      mask |= 0x8000;  // SQUARE
        if (k & KEY_Y)      mask |= 0x1000;  // TRIANGLE
        if (k & KEY_L)      mask |= 0x100;   // LTRIGGER
        if (k & KEY_R)      mask |= 0x200;   // RTRIGGER
        if (k & KEY_START)  mask |= 0x08;    // START
        if (k & KEY_SELECT) mask |= 0x01;    // SELECT

        // JS frame(mask): runs Solid effects + the renderer's end-of-frame sweep.
        if (have_frame) {
            JSValue arg = JS_NewInt32(ctx, mask);
            JSValue ret = JS_Call(ctx, frame, global, 1, &arg);
            if (JS_IsException(ret)) dump_exception(ctx);
            JS_FreeValue(ctx, ret);
            JS_FreeValue(ctx, arg);
        }
        // Drain queued microtasks (queueMicrotask polyfill = promise jobs).
        JSContext *pctx;
        while (JS_ExecutePendingJob(rt, &pctx) > 0) {}

        // Core frame: fixed-dt animations + relayout, then rasterize + present.
        pj_tick();
        present(pj_render(), sw, sh);

        gfxFlushBuffers();
        gfxSwapBuffers();
        gspWaitForVBlank();
    }

    JS_FreeValue(ctx, frame);
    JS_FreeValue(ctx, global);
    JS_FreeContext(ctx);
    JS_FreeRuntime(rt);
    gfxExit();
    return 0;
}
