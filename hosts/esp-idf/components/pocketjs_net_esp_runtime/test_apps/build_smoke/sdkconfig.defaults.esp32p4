## hosts/esp-idf/components/pocketjs_net_http_client_core/test_apps/build_smoke/sdkconfig.defaults
```kconfig
CONFIG_COMPILER_OPTIMIZATION_SIZE=y
CONFIG_LWIP_DNS_MAX_HOST_IP=4
CONFIG_MBEDTLS_CERTIFICATE_BUNDLE=y
CONFIG_MBEDTLS_CERTIFICATE_BUNDLE_DEFAULT_FULL=y
CONFIG_MBEDTLS_SSL_PROTO_TLS1_2=y
# CONFIG_MBEDTLS_SSL_PROTO_TLS1_3 is not set
# CONFIG_MBEDTLS_SSL_RENEGOTIATION is not set
# CONFIG_MBEDTLS_ALLOW_WEAK_CERTIFICATE_VERIFICATION is not set
# CONFIG_MBEDTLS_CERTIFICATE_BUNDLE_DEPRECATED_LIST is not set
# CONFIG_MBEDTLS_DES_C is not set
# CONFIG_ESP_TLS_INSECURE is not set
```

## hosts/esp-idf/examples/net-smoke/firmware/main/Kconfig.projbuild
```kconfig
menu "PocketJS network smoke"

    config SMOKE_BOARD_NAME
        string "Board name reported by the guest"
        default "esp32"

    config SMOKE_WIFI_SSID
        string "Wi-Fi SSID"
        default ""

    config SMOKE_WIFI_PASSWORD
        string "Wi-Fi password"
        default ""

    config SMOKE_MAC_HOST
        string "Workstation peer address (tools/net-peer.ts); empty disables"
        default ""

    config SMOKE_MAC_HTTP_PORT
        int "Workstation peer HTTP port"
        default 8790

    config SMOKE_MAC_WS_PORT
        int "Workstation peer WebSocket port"
        default 8791

    config SMOKE_PEER_HOST
        string "Peer board address; empty disables the board-to-board suite"
        default ""

    config SMOKE_PEER_PORT
        int "Peer board HTTP port"
        default 8080

    config SMOKE_PEER_PING
        bool "Ping the peer board every ~2 s after the suite"
        default y

    config SMOKE_SERVE_PORT
        int "Port the guest serves on"
        default 8080

    config SMOKE_TICK_HZ
        int "Guest tick rate"
        default 60

    config SMOKE_GUEST_MEMORY_KB
        int "QuickJS memory limit (KiB)"
        default 4096

    config SMOKE_GUEST_STACK_KB
        int "Guest owner task stack (KiB)"
        default 32

    config SMOKE_ENABLE_TLS
        bool "Run the HTTPS/TLS suite against public hosts (needs internet + SNTP)"
        default n

    config SMOKE_TLS_HOST
        string "Public HTTPS host for the positive TLS check"
        default "example.com"

endmenu
```

## hosts/esp-idf/examples/net-smoke/firmware/sdkconfig.defaults.esp32s3
```kconfig
# AtomS3R: ESP32-S3-PICO-1-N8R8 (8 MB flash, 8 MB octal PSRAM).
CONFIG_ESPTOOLPY_FLASHSIZE_8MB=y
CONFIG_ESPTOOLPY_FLASHMODE_QIO=y
CONFIG_ESPTOOLPY_FLASHFREQ_80M=y
CONFIG_SPIRAM=y
CONFIG_SPIRAM_MODE_OCT=y
CONFIG_SPIRAM_SPEED_80M=y
CONFIG_SPIRAM_USE_MALLOC=y
CONFIG_SPIRAM_MALLOC_ALWAYSINTERNAL=4096
CONFIG_SPIRAM_MALLOC_RESERVE_INTERNAL=65536
CONFIG_SPIRAM_TRY_ALLOCATE_WIFI_LWIP=y
CONFIG_ESP_DEFAULT_CPU_FREQ_MHZ_240=y
CONFIG_ESP32S3_DEFAULT_CPU_FREQ_240=y
CONFIG_SMOKE_BOARD_NAME="atoms3r"
```

## hosts/esp32p4/waveshare-7b/sdkconfig.defaults
```kconfig
# ESP32-P4 v1.x-safe defaults for Waveshare ESP32-P4-WIFI6-Touch-LCD-7B.
# The connected part is revision 1.3, so retain the vendor's pre-v3 choice.
CONFIG_IDF_TARGET="esp32p4"
CONFIG_ESP32P4_SELECTS_REV_LESS_V3=y
CONFIG_ESP32P4_REV_MIN_1=y

CONFIG_ESPTOOLPY_FLASHMODE_QIO=y
CONFIG_ESPTOOLPY_FLASHSIZE_32MB=y
CONFIG_ESPTOOLPY_FLASHSIZE="32MB"
CONFIG_SPI_FLASH_SUPPORT_GD_CHIP=y
CONFIG_PARTITION_TABLE_CUSTOM=y
CONFIG_PARTITION_TABLE_CUSTOM_FILENAME="partitions.csv"
CONFIG_PARTITION_TABLE_FILENAME="partitions.csv"

CONFIG_SPIRAM=y
CONFIG_SPIRAM_SPEED_200M=y
CONFIG_SPIRAM_XIP_FROM_PSRAM=y
CONFIG_SPIRAM_USE_MALLOC=y
CONFIG_SPIRAM_MALLOC_ALWAYSINTERNAL=4096
CONFIG_SPIRAM_MALLOC_RESERVE_INTERNAL=32768
CONFIG_FREERTOS_TASK_CREATE_ALLOW_EXT_MEM=y
CONFIG_CACHE_L2_CACHE_256KB=y
CONFIG_CACHE_L2_CACHE_LINE_128B=y

CONFIG_COMPILER_OPTIMIZATION_PERF=y
CONFIG_ESP_MAIN_TASK_STACK_SIZE=49152
CONFIG_PTHREAD_TASK_STACK_SIZE_DEFAULT=8192
CONFIG_ESP_CONSOLE_UART_DEFAULT=y
CONFIG_ESPTOOLPY_MONITOR_BAUD=115200
CONFIG_FREERTOS_HZ=1000

CONFIG_BSP_LCD_DPI_BUFFER_NUMS=1
CONFIG_BSP_LCD_COLOR_FORMAT_RGB565=y
# CONFIG_BSP_DISPLAY_LVGL_AVOID_TEAR is not set

CONFIG_LV_OS_FREERTOS=y
CONFIG_LV_USE_CLIB_MALLOC=y
CONFIG_LV_USE_CLIB_STRING=y
CONFIG_LV_USE_CLIB_SPRINTF=y
CONFIG_LV_DEF_REFR_PERIOD=15
CONFIG_LV_OBJ_STYLE_CACHE=y
CONFIG_LV_DRAW_SW_DRAW_UNIT_CNT=2
CONFIG_LV_ATTRIBUTE_FAST_MEM_USE_IRAM=y
CONFIG_LV_USE_CANVAS=y
# CONFIG_LV_BUILD_EXAMPLES is not set

CONFIG_IDF_EXPERIMENTAL_FEATURES=y
```

## hosts/sifli/Kconfig
```kconfig
menu "PocketJS host"

rsource "components/pocketjs_gpu/Kconfig"
rsource "components/pocketjs_host/Kconfig"

endmenu
```

## hosts/sifli/components/pocketjs_gpu/Kconfig
```kconfig
menuconfig POCKETJS_GPU
    bool "PocketJS GPU command queue (EPIC / VG Lite)"
    default y
    depends on BF0_HCPU
    help
      The C executor behind hosts/sifli/include/pocketjs_gpu.h. Runs the
      renderer's fills, A8 blends, gradients, native texture blits, and CPU
      fallback tile copies on EPIC through the SiFli HAL.

if POCKETJS_GPU

config POCKETJS_GPU_MASK_TILE_KB
    int "A8 plane size per slot (KB, two slots in SRAM)"
    default 64
    range 4 512

config POCKETJS_GPU_CPU_TILE_KB
    int "RGB565 tile size per slot for CPU fallback (KB, two slots in SRAM)"
    default 64
    range 4 512

config POCKETJS_GPU_MAX_TEXTURES
    int "Native texture registry capacity"
    default 32
    range 1 256

config POCKETJS_GPU_MIN_PIXELS
    int "Smallest rectangle (physical pixels) worth a hardware transaction"
    default 64
    range 1 1048576

config POCKETJS_GPU_DIRECT_CPU_WRITES
    bool "Let the renderer write the framebuffer from the CPU"
    default n
    help
      Off keeps every CPU fallback inside SRAM tiles that EPIC copies in and
      out, so the framebuffer stays GPU-only. Turn on only when the
      framebuffer is CPU-writable without cache maintenance and profiling
      shows tile copies cost more than direct writes.

endif

if POCKETJS_GPU

config POCKETJS_GPU_VGLITE
    bool "Run transformed, tinted, and portable-format blits on VG Lite (SF32LB58)"
    default y
    depends on USING_VGLITE
    help
      Adds a second executor for the commands EPIC cannot run on 58x:
      four-point (projective) texture quads, RGB-modulated blits, and
      textures kept in PocketJS portable formats. Commands switch engines
      with a drain of the other engine; the profiler counts the switches.

config POCKETJS_GPU_VGLITE_POOL_KB
    int "VG Lite contiguous pool in SRAM (KB)"
    default 320
    range 128 1024
    depends on POCKETJS_GPU_VGLITE

config POCKETJS_GPU_VGLITE_CMD_KB
    int "VG Lite command buffer (KB, two of them come from the pool)"
    default 64
    range 16 256
    depends on POCKETJS_GPU_VGLITE

endif
```

## hosts/sifli/components/pocketjs_host/Kconfig
```kconfig
menuconfig POCKETJS_HOST
    bool "PocketJS host (QuickJS guest, framebuffer ring, input)"
    default y
    depends on POCKETJS_GPU && PKG_USING_QUICKJS && BSP_USING_LCD && RT_USING_MEMHEAP
    help
      The reusable firmware host: a bounded PSRAM heap shared by QuickJS and
      the Rust core, the RGB565 framebuffer ring presented through the
      RT-Thread LCD device, board keys and touch mapped to the PocketJS input
      contract, one mounted guest at a time from an embedded catalog, and
      the serial profiler.

if POCKETJS_HOST

config POCKETJS_LOGICAL_WIDTH
    int "Guest viewport width (logical pixels)"
    default 512

config POCKETJS_LOGICAL_HEIGHT
    int "Guest viewport height (logical pixels)"
    default 300

config POCKETJS_RENDER_SCALE
    int "Integer render scale (physical pixels per logical pixel)"
    default 2
    range 1 4

config POCKETJS_RASTER_DENSITY
    int "Raster density the guest assets were baked at"
    default 2
    range 1 4

config POCKETJS_TICK_HZ
    int "Guest frame rate (Hz)"
    default 60
    range 1 120

config POCKETJS_FRAMEBUFFER_COUNT
    int "RGB565 framebuffers in the presentation ring"
    default 3
    range 2 4
    help
      RAM-less DPI panels need three: one scanned, one pending, one being
      rendered. Each framebuffer keeps its own damage tracker.

config POCKETJS_HEAP_KB
    int "Shared QuickJS + Rust heap in cached PSRAM (KB)"
    default 7168

config POCKETJS_QJS_MEMORY_LIMIT_KB
    int "QuickJS runtime memory limit inside the shared heap (KB)"
    default 4096

config POCKETJS_MPU_OVERRIDE
    bool "Override the SDK MPU table: PSRAM1 cached, PSRAM2 non-cacheable"
    default y
    help
      SF32LB58x only (the chip is a compiler define, not a Kconfig symbol;
      host_mpu.c refuses other chips). The framebuffer ring lives in
      PSRAM2. Marking that window normal non-cacheable at startup lets EPIC
      and the LCD controller observe CPU writes without cache maintenance.
      Adding the region later, after the SDK table is live, raises DACCVIOL
      on the first framebuffer write.

config POCKETJS_KEY_LONG_PRESS_MS
    int "Key long-press threshold (ms); 0 keeps level semantics"
    default 0
    help
      0: KEY1/KEY2 levels are reported as LEFT/RIGHT every frame.
      >0: a key emits one LEFT/RIGHT pulse on release; holding KEY2 on the
      launcher emits one CIRCLE pulse, holding KEY1 in a guest returns to
      the launcher.

config POCKETJS_INPUT_TOUCH
    bool "Forward touch contacts to the guest"
    default y
    depends on BSP_USING_TOUCHD

config POCKETJS_NATIVE_TEXTURE_STAGING
    bool "Copy native texture blobs into the heap before registering them"
    default y
    help
      Native (.epic) blobs are linked into code rodata. Copying them into
      the cached PSRAM heap once per guest mount keeps EPIC reads on the
      data bus.

config POCKETJS_PROFILE
    bool "Print frame, render, and work statistics once per second"
    default y

endif

if POCKETJS_HOST

config POCKETJS_FORCE_SOFTWARE
    bool "Render every frame with the core software rasterizer (bring-up)"
    default n
    help
      Bypasses the GPU queue: each frame is a full software render into the
      framebuffer. Use it to validate the heap, MPU, LCD ring, and input
      before trusting the hardware path.

config POCKETJS_SELF_CHECK
    bool "Compare hardware frames against the software rasterizer"
    default n
    help
      Every POCKETJS_SELF_CHECK_INTERVAL frames the current DrawList is
      also rendered by the core software rasterizer into a scratch PSRAM
      buffer and compared pixel by pixel; the serial port reports the
      mismatch ratio, PSNR, the largest channel delta, both CRC32s, and up
      to 16 differing pixels. `bun tools/sifli.ts selfcheck <log>` applies
      the acceptance thresholds.

config POCKETJS_SELF_CHECK_INTERVAL
    int "Frames between self-checks"
    default 60
    range 1 3600
    depends on POCKETJS_SELF_CHECK

config POCKETJS_FRAME_CRC
    bool "Print a CRC32 of every presented frame"
    default n
    help
      `[PocketJS] crc frame=<n> hash=<draw hash> crc=<crc32>` per frame
      for `bun tools/sifli.ts crc <output> --assert <log>`, which renders
      the same guest through the simulator's RGB565 path and compares the
      sequence. Costs one uncached read of the framebuffer per frame.

endif
```

## hosts/sifli/examples/hero-smoke/project/Kconfig.proj
```kconfig
#APP specific configuration.
source "$POCKETJS_ROOT/hosts/sifli/Kconfig"

config CUSTOM_MEM_MAP
    bool
	select custom_mem_map
	default y if !SOC_SIMULATOR
```
